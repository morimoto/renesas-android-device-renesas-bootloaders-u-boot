## board/renesas/salvator-x/Kconfig
```kconfig
if TARGET_SALVATOR_X

config SYS_SOC
	default "rmobile"

config SYS_BOARD
	default "salvator-x"

config SYS_VENDOR
	default "renesas"

config SYS_CONFIG_NAME
	default "salvator-x"

config FASTBOOT_BY_SW
bool "Enter fastboot by SW22"
	default n
	depends on R8A7795 || R8A7796
	help
	  Allows to enter at fastboot mode while
	  holding down SW22 button

config DEFAULT_IPL_IMAGE_SIZE
int "Default IPL image size"
	default 4194304
	depends on R8A7795 || R8A7796
	help
	  Defines the default IPL image size.

config CMD_DTBOINFO
bool "Get information about dtbo"
	default y
	depends on R8A7795 || R8A7796
	help
	  Get information about dtbo

endif
```

## board/renesas/ulcb/Kconfig
```kconfig
if TARGET_ULCB

config SYS_SOC
	default "rmobile"

config SYS_BOARD
	default "ulcb"

config SYS_VENDOR
	default "renesas"

config SYS_CONFIG_NAME
	default "ulcb"

config FASTBOOT_BY_SW
bool "Enter fastboot by SW3"
	default n
	depends on R8A7795 || R8A7796
	help
	  Allows to enter at fastboot mode while
	  holding down SW3 button

endif
```

## configs/r8a7796_salvator-x_defconfig
```kconfig
CONFIG_ARM=y
CONFIG_ARCH_RMOBILE=y
CONFIG_SYS_TEXT_BASE=0x50000000
CONFIG_SYS_MALLOC_F_LEN=0x2000
CONFIG_RCAR_GEN3=y
CONFIG_R8A7796=y
CONFIG_TARGET_SALVATOR_X=y
CONFIG_SMBIOS_PRODUCT_NAME=""
CONFIG_FIT=y
# CONFIG_ARCH_FIXUP_FDT_MEMORY is not set
CONFIG_BOOTDELAY=3
CONFIG_USE_BOOTARGS=y
CONFIG_BOOTARGS="video=VGA-1:d video=LVDS-1:d"
CONFIG_USE_BOOTCOMMAND=y
CONFIG_BOOTCOMMAND="boota 1 boot 0x4C000000"
CONFIG_SUPPORT_RAW_INITRD=y
CONFIG_VERSION_VARIABLE=y
CONFIG_AVB_VERIFY=y
CONFIG_HUSH_PARSER=y
CONFIG_CMD_BOOTZ=y
CONFIG_CMD_GPIO=y
CONFIG_CMD_GPT=y
CONFIG_CMD_I2C=y
CONFIG_CMD_MMC=y
# CONFIG_CMD_MMC_RPMB is not set
CONFIG_CMD_MMC_SWRITE=y
CONFIG_CMD_USB=y
CONFIG_CMD_DHCP=y
CONFIG_CMD_MII=y
CONFIG_CMD_PING=y
CONFIG_CMD_CACHE=y
CONFIG_CMD_UUID=y
CONFIG_CMD_EXT2=y
CONFIG_CMD_EXT4=y
CONFIG_CMD_EXT4_WRITE=y
CONFIG_CMD_FAT=y
CONFIG_CMD_FS_GENERIC=y
CONFIG_CMD_FS_UUID=y
CONFIG_CMD_AVB=y
CONFIG_OF_CONTROL=y
CONFIG_DEFAULT_DEVICE_TREE="r8a7796-salvator-x-u-boot"
CONFIG_OF_LIST="r8a7796-salvator-x-u-boot r8a7796-salvator-xs-u-boot r8a7796-salvator-xs-2x4g-u-boot"
CONFIG_MULTI_DTB_FIT=y
CONFIG_ENV_IS_IN_MMC=y
CONFIG_REGMAP=y
CONFIG_SYSCON=y
CONFIG_CLK=y
CONFIG_CLK_RENESAS=y
CONFIG_USB_FUNCTION_FASTBOOT=y
CONFIG_FASTBOOT_BUF_ADDR=0x4A000000
CONFIG_FASTBOOT_BUF_SIZE=0x1000000
CONFIG_FASTBOOT_USB_DEV=24
CONFIG_FASTBOOT_FLASH=y
CONFIG_FASTBOOT_FLASH_MMC_DEV=1
CONFIG_DM_GPIO=y
CONFIG_RCAR_GPIO=y
CONFIG_DM_I2C=y
CONFIG_I2C_SET_DEFAULT_BUS_NUM=y
CONFIG_I2C_DEFAULT_BUS_NUMBER=0x7
CONFIG_SYS_I2C_RCAR_IIC=y
CONFIG_DM_MMC=y
CONFIG_SUPPORT_EMMC_RPMB=y
CONFIG_MMC_IO_VOLTAGE=y
CONFIG_MMC_UHS_SUPPORT=y
CONFIG_MMC_HS200_SUPPORT=y
CONFIG_RENESAS_SDHI=y
CONFIG_PHY_MICREL=y
CONFIG_PHY_MICREL_KSZ90X1=y
CONFIG_DM_ETH=y
CONFIG_RENESAS_RAVB=y
CONFIG_PINCTRL=y
CONFIG_PINCONF=y
CONFIG_PINCTRL_PFC=y
CONFIG_DM_REGULATOR=y
CONFIG_DM_REGULATOR_FIXED=y
CONFIG_DM_REGULATOR_GPIO=y
CONFIG_SCIF_CONSOLE=y
CONFIG_USB=y
CONFIG_DM_USB=y
CONFIG_USB_XHCI_HCD=y
CONFIG_USB_EHCI_HCD=y
CONFIG_USB_EHCI_GENERIC=y
CONFIG_USB_STORAGE=y
CONFIG_USB_GADGET=y
CONFIG_USB_GADGET_MANUFACTURER="Renesas"
CONFIG_USB_GADGET_VENDOR_NUM=0x18D1
CONFIG_USB_GADGET_PRODUCT_NUM=0x4E26
CONFIG_USB_RENESAS_USBHS=y
CONFIG_CMD_FASTBOOT=y
CONFIG_LIBAVB=y
CONFIG_LIBAVB_AB=y
CONFIG_FASTBOOT_BY_SW=y
CONFIG_LZ4=y
CONFIG_OF_LIBFDT_OVERLAY=y
CONFIG_SMBIOS_MANUFACTURER=""
```

## drivers/video/renesas/Kconfig
```kconfig
menuconfig VIDEO_RENESAS
	bool "Enable Renesas Video Support"
	help
	  Renesas SoCs provide video output capabilities for High-Definition
	  Multimedia Interface (HDMI).

config VIDEO_RENESAS_DISPLAY_WIDTH
        int "Display horizontal resolution"
	depends on VIDEO_RENESAS
	default 1280

config VIDEO_RENESAS_DISPLAY_HEIGHT
        int "Display vertical resolution"
	depends on VIDEO_RENESAS
	default 720

config VIDEO_RENESAS_BUF_ADDR
        hex "Buffer address for loading logo images"
	depends on VIDEO_RENESAS
	default 0x58600000

config VIDEO_RENESAS_BUF_SIZE
        hex "Buffer size for loading logo images"
	depends on VIDEO_RENESAS
	default 0x2000
```
